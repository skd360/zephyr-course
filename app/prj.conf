## CMakeLists.txt
```
cmake_minimum_required(VERSION 3.20.0)

list(APPEND BOARD_ROOT ${CMAKE_CURRENT_SOURCE_DIR})
find_package(Zephyr REQUIRED)

project(my_zephyr_app)

# target_sources(app PRIVATE 
#                src/main.cpp
#             #    drivers/our_driver/our_driver.c
#                  drivers/our_driver/our_driver.h
#                )
# target_include_directories(app PRIVATE include)
add_subdirectory(src)
target_include_directories(app PRIVATE ${CMAKE_CURRENT_SOURCE_DIR}/drivers/our_driver)
add_subdirectory(drivers/our_driver)
```

## Kconfig
```
#config BLINK_SPEED_TIME_MS
config APP_HEARTBEAT_PERIOD_MS
   int "APP_HEARTBEAT_PERIOD_MS"
   #int
   # default 1000 if BLINK_SLEEP_TIME_1000MS
   # default 100 if BLINK_SLEEP_TIME_100MS
   # default 3000 if BLINK_SLEEP_TIME_3000MS
   range 100 2000
   default 500
   help
     help helpy can be multi-timey
     like this oneeee.
menuconfig LED_SUBSYSTEM
    bool "Led Subsys"
    default y

if LED_SUBSYSTEM
menu "LED blink sleep time (1s (mid))"
choice
  prompt "Led Blink Speed"
  default BLINK_SLEEP_TIME_1000MS
config BLINK_SLEEP_TIME_100MS
   bool "fast af"
config BLINK_SLEEP_TIME_1000MS
   bool "mid"
config BLINK_SLEEP_TIME_3000MS
   bool "slow af"
endchoice

# #config BLINK_SPEED_TIME_MS
# config BLINK_SLEEP_TIME_MS
#    int "APP_HEARTBEAT_PERIOD_MS"
#    #int
#    # default 1000 if BLINK_SLEEP_TIME_1000MS
#    # default 100 if BLINK_SLEEP_TIME_100MS
#    # default 3000 if BLINK_SLEEP_TIME_3000MS
#    range 100 2000
#    default 500
#    help
#      help helpy can be multi-timey
#      like this oneeee.
endmenu
endif

menuconfig ADVANCED_LED_SETTINGS
    depends on LED_SUBSYSTEM
     bool "advanced led"
     default n

if ADVANCED_LED_SETTINGS
     config LED_BRIGHTNESS
       int "LED_BRIGHTNESS(0-100)"
       range 0 100
       default 100
     config LED_FADE_DURATION
       int "LED fade duration (ms)"
       default 500
menu "Expert settings"
visible if ADVANCED_LED_SETTINGS
config Enable_LED_Debugging
     bool "debug_enable"
     default n
config CUSTOM_BLINK_PATTERN
     bool "blinky_pattern"
     default n
endmenu
endif 

source "Kconfig.zephyr"
rsource "drivers/our_driver/Kconfig"
```

## prj.conf
```kconfig
CONFIG_GPIO=y
CONFIG_LOG=y
CONFIG_SHELL=y
CONFIG_SHELL_BACKEND_SERIAL=y
CONFIG_SENSOR=y
CONFIG_SENSOR_SHELL=y
CONFIG_BLINK_SLEEP_TIME_3000MS=y
CONFIG_OUR_DRIVER=y
```

## boards/app.overlay
```dts
/{
    aliases{
        appled = &green_led_2;

    };

};
```

## boards/nucleo_f446re.overlay
```dts
/ {
    leds: leds {
        red_led: led0 {
            gpios = <&gpioa 1 GPIO_ACTIVE_HIGH>;
        };
    };
    our_driver0: our_driver{
        compatible = "our,driver";
        status = "okay";
    };
    // our_driver1: our_driver1{
    //     compatible = "our,driver";
    //     status = "okay";
    // };
};
```

## dts/bindings/our,driver.yaml
```yaml
description: our simple driver binding
compatible: "our,driver"
include: base.yaml
```

## src/main.cpp
```c
#include <zephyr/drivers/gpio.h>
#include <zephyr/kernel.h>
#include <zephyr/logging/log.h>

//#define SLEEP_TIME_MS 1000 //removing this for testing kconfig

/* The devicetree node identifier for the "led0" alias. */
//#define LED_NODE DT_ALIAS(led0)
///////////////////#define LED_NODE DT_ALIAS(appled)

//static const struct gpio_dt_spec led = GPIO_DT_SPEC_GET(LED_NODE, gpios);

LOG_MODULE_REGISTER(main, LOG_LEVEL_INF);

int main(void)
{
    // bool led_state = true;

    // if (!gpio_is_ready_dt(&led)) return 0;

    // if (gpio_pin_configure_dt(&led, GPIO_OUTPUT_ACTIVE) < 0) return 0;

    while (1) {
        LOG_INF("Hello World! %s", CONFIG_BOARD);
        // if (gpio_pin_toggle_dt(&led) < 0) return 0;

        // led_state = !led_state;
        // LOG_INF("LED state: %s", led_state ? "ON" : "OFF");
        k_msleep(CONFIG_APP_HEARTBEAT_PERIOD_MS);
    }
    return 0;
}
```

## include/our_driver.h
```c
#ifndef OUR_DRIVER_H
#define OUR_DRIVER_H

#include <zephyr/device.h>
#include <zephyr/drivers/sensor.h>

/*
 * Our custom API structure.
 *
 * IMPORTANT:
 * sensor_driver_api MUST be first.
 */
struct our_driver_api {
    struct sensor_driver_api sensor_api;

    int (*set_custom_value)(
        const struct device *dev,
        int value
    );
};


/*
 * Function main.cpp will call.
 */
static inline int our_driver_set_custom_value(
    const struct device *dev,
    int value)
{
    const struct our_driver_api *api =
        (const struct our_driver_api *)dev->api;

    return api->set_custom_value(dev, value);
}

#endif
// #pragma once

// #include <zephyr/device.h>
// #include <zephyr/drivers/sensor.h>

// typedef int (*our_driver_set_value_t)(
//     const struct device *dev,
//     int value
// );

// __subsystem struct our_driver_api {
//     struct sensor_driver_api sensor_api;

//     our_driver_set_value_t set_custom_value;
// };

// static inline int our_driver_set_value(
//     const struct device *dev,
//     int value)
// {
//     const struct our_driver_api *api =
//         DEVICE_API_GET(our_driver, dev);

//     return api->set_custom_value(dev, value);
// }
```

## src/led.c
```c
#include <zephyr/kernel.h>
#include <zephyr/drivers/gpio.h>

static const struct gpio_dt_spec led = GPIO_DT_SPEC_GET(DT_ALIAS(led0), gpios);

int main(void)
{
    if (!gpio_is_ready_dt(&led))
        return 0;
    gpio_pin_configure_dt(&led, GPIO_OUTPUT_ACTIVE);
    while (1)
    {
        gpio_pin_toggle_dt(&led);
        k_msleep(1000);
    }
}
```
